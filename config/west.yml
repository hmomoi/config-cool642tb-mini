## config/west.yml
```yaml
manifest:  
  remotes:  
    - name: zmkfirmware  
      url-base: https://github.com/zmkfirmware  
    - name: na-ka-no
      url-base: https://github.com/na-ka-no
    - name: prospector
      url-base: https://github.com/t-ogura
  projects:  
    - name: zmk
      remote: na-ka-no  # フォークしたリポジトリを参照  
      revision: for-cool642tb_mini  # カスタムブランチ名  
      import: app/west.yml  
    - name: zmk-pmw3610-driver  
      remote: na-ka-no
      revision: main  
    # Add this:
    - name: prospector-zmk-module
      remote: prospector
      revision: v2.2.1
      path: modules/prospector-zmk-module
  self:  
    path: config
```
